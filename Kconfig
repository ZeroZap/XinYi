## Kconfig
```kconfig
# XinYi Framework Kconfig Configuration
# Similar to Zephyr/ESP-IDF configuration system

menu "XinYi Framework Configuration"

config XY_VERSION
    string
    default "1.0.0"

menu "Platform Selection"

config PLATFORM_PC
    bool "PC Simulation (Windows/Linux/macOS)"
    default y
    select HAL_PC
    select HAS_STDIO
    help
      Build for PC simulation with standard C library support.
      Supports Windows, Linux, and macOS.

config PLATFORM_STM32
    bool "STM32 Series"
    select HAL_STM32
    select ARM_CORTEX_M

config PLATFORM_STM32U5
    bool "STM32U5 Series (High-performance)"
    depends on PLATFORM_STM32
    select CORTEX_M33
    select FPU
    help
      STM32U5 series with TrustZone and advanced security features.

config PLATFORM_STM32F4
    bool "STM32F4 Series (Mainstream)"
    depends on PLATFORM_STM32
    select CORTEX_M4
    select FPU
    help
      STM32F4 series with FPU, suitable for DSP applications.

config PLATFORM_STM32F1
    bool "STM32F1 Series (Entry-level)"
    depends on PLATFORM_STM32
    select CORTEX_M3
    help
      STM32F1 series, cost-effective solution.

config PLATFORM_WCH
    bool "WCH CH32 Series"
    select HAL_WCH
    help
      WCH (QinHeng) CH32V/RISC-V series.

config PLATFORM_HC32
    bool "Huada HC32 Series"
    select HAL_HC32
    help
      Huada Semiconductor HC32 series (ARM/RISC-V).

endmenu # Platform Selection

menu "HAL Configuration"

config HAL_PC
    bool
    select HAVE_DELAY_MS
    select HAVE_DELAY_US

config HAL_STM32
    bool

config HAL_WCH
    bool

config HAL_HC32
    bool

config HAL_USE_STANDARD_API
    bool "Use unified HAL API"
    default n
    help
      Use the unified HAL API across all platforms.

endmenu # HAL Configuration

menu "Core Components"

config COMPONENT_DEVICE
    bool "Device Framework"
    default n
    help
      Unified device management framework.

config COMPONENT_CHARGER
    bool "Charger Management"
    default n
    select COMPONENT_DEVICE
    help
      Battery charger management (BQ25620, etc).

config COMPONENT_CRYPTO
    bool "Crypto Library"
    default n
    help
      Lightweight cryptography library (AES, SHA, CRC, etc).

config COMPONENT_DM
    bool "Device Management"
    default y
    help
      Advanced device management with JSON/Flash support.

config COMPONENT_SENSOR
    bool "Sensor Framework"
    default n
    help
      Sensor abstraction layer.

endmenu # Core Components

menu "GUI Subsystem"

config GUI_ENABLED
    bool "Enable GUI Subsystem"
    default y
    help
      Enable graphical user interface support.

config GUI_SDL
    default y
    bool "SDL2 Backend (PC)"
    depends on GUI_ENABLED && PLATFORM_PC
    select SDL2
    help
      SDL2-based GUI backend for PC platforms.
      Provides windowing, input, and rendering.

config GUI_TFT
    bool "TFT LCD Backend (Embedded)"
    depends on GUI_ENABLED && (PLATFORM_STM32U5 || PLATFORM_STM32F4)
    help
      TFT LCD driver for embedded platforms.
      Supports SPI/I8080/RGB interfaces.

config GUI_LVGL
    default y
    bool "LVGL Integration"
    depends on GUI_ENABLED
    help
      Integrate LVGL graphics library.

config GUI_WIDGETS
    bool "Built-in Widgets"
    depends on GUI_ENABLED
    default n
    help
      Built-in widget library (Button, Label, Slider, etc).

endmenu # GUI Subsystem

menu "Communication Protocols"

config NETWORK
    bool "Network Support"
    default y
    help
      Basic network support for communication protocols.

config PROTO_MQTT
    bool "MQTT Protocol"
    default y
    select NETWORK
    help
      MQTT client for IoT connectivity.

config PROTO_HTTP
    bool "HTTP Client"
    default n
    select NETWORK
    help
      HTTP/HTTPS client support.

config PROTO_COAP
    bool "CoAP Protocol"
    default n
    select NETWORK
    help
      CoAP for constrained devices.

endmenu # Communication Protocols

menu "File System"

config FS_ENABLED
    bool "File System Support"
    default n

config FS_FATFS
    bool "FatFs"
    depends on FS_ENABLED
    help
      FatFs file system for SD/eMMC.

config FS_LITTLEFS
    bool "LittleFS"
    depends on FS_ENABLED
    help
      LittleFS for internal flash.

endmenu # File System

menu "Power Management"

config PM_ENABLED
    bool "Power Management"
    default n if PLATFORM_STM32
    help
      Power management framework.

config PM_SLEEP_MODES
    bool "Sleep Modes"
    depends on PM_ENABLED
    help
      Support for sleep/stop/standby modes.

config PM_DYNAMIC_VOLTAGE
    bool "Dynamic Voltage Scaling"
    depends on PM_ENABLED
    help
      Dynamic voltage and frequency scaling.

endmenu # Power Management

menu "Logging & Debug"

config LOG_ENABLED
    bool "Logging System"
    default n
    help
      Unified logging framework.

config LOG_LEVEL
    int "Log Level"
    depends on LOG_ENABLED
    default 3
    range 0 4
    help
      0=OFF, 1=ERROR, 2=WARNING, 3=INFO, 4=DEBUG

config LOG_COLOR
    bool "Colored Output"
    depends on LOG_ENABLED && PLATFORM_PC
    default n
    help
      Enable colored log output.

config ASSERT_ENABLED
    bool "Assertions"
    default n
    help
      Enable runtime assertions.

endmenu # Logging & Debug

menu "Advanced Options"

config BUILD_SHARED_LIBS
    bool "Build shared libraries"
    default n
    help
      Build components as shared libraries instead of static.

config BUILD_TESTING
    bool "Build tests"
    default n
    help
      Build unit tests for components.

config ENABLE_COVERAGE
    bool "Enable code coverage"
    depends on BUILD_TESTING && PLATFORM_PC
    default n
    help
      Enable code coverage analysis.

config ENABLE_SANITIZER
    bool "Enable sanitizers"
    depends on BUILD_TESTING && PLATFORM_PC
    default n
    help
      Enable AddressSanitizer/UBSan for debugging.

endmenu # Advanced Options

endmenu # XinYi Framework Configuration
```

## components/fuel_gauge/Kconfig
```kconfig
config COMPONENT_FUEL_GAUGE
    bool "FUEL_GAUGE Component"
    default y
    select COMPONENT_DEVICE
    help
      Fuel gauge core plus the BQ27Z746/BQ27Z561/BQ40Z50/MAX17043 drivers.

      The drivers reach the bus through the canonical Device helpers
      (`xy_i2c_device_read_reg16_repeated_start()` and friends), so this
      component cannot be built without COMPONENT_DEVICE.

      NOTE: this fragment is not read by the build. `cmake/kconfig_parser.py`
      parses the root `Kconfig` only (it refuses `source`), so the
      authoritative definition lives in `Kconfig` under "Additional
      Components" and this file mirrors it. Change both, and let
      `check_kconfig_fragment_agreement.py` keep them consistent.
```

## components/sensor/Kconfig
```kconfig
# Kconfig for XY sensor Component

config XY_SENSOR_ENABLE
    bool "sensor component support"
    default y
    select COMPONENT_DEVICE
    help
      Enable support for the sensor component.
      This component provides sensor drivers.

      The canonical drivers this component links reach the bus through the
      Device framework, so `COMPONENT_DEVICE` is not optional. The relation is
      declared in the root `Kconfig` too, because that is the only file
      `cmake/kconfig_parser.py` reads; this fragment is documentation and
      `check_kconfig_fragment_agreement.py` fails if the two disagree.

if XY_SENSOR_ENABLE

config XY_SENSOR_TEST
    bool "Enable sensor component tests"
    default y
    depends on XY_SENSOR_ENABLE
    help
      Enable unit tests for the sensor component.

config XY_SENSOR_EXAMPLE
    bool "Enable sensor component examples"
    default y
    depends on XY_SENSOR_ENABLE
    help
      Enable example applications for the sensor component.

endif # XY_SENSOR_ENABLE
```

## third_party/Kconfig
```kconfig
# Third Party Libraries Kconfig

menu "Third Party Libraries Configuration"

config USE_THIRD_PARTY_LIBS
    bool "Enable third party libraries"
    default y
    help
        Enable third party library support.

# ==================== RTOS Selection ====================

choice
    prompt "RTOS Selection"
    default RTOS_NONE
    help
        Select the RTOS backend for your project.
        Only one RTOS can be selected at a time.

config RTOS_NONE
    bool "No RTOS (Bare-metal)"
    help
        No RTOS, use bare-metal mode.
        Suitable for simple applications without multi-threading.

config RTOS_FREERTOS
    bool "FreeRTOS"
    help
        Use FreeRTOS RTOS.
        License: MIT
        Website: https://www.freertos.org/

        Features:
        - Preemptive priority-based scheduler
        - Mutex, Semaphore, Event Groups
        - Software Timers
        - Message Queues
        - Task Notifications

config RTOS_RTTHREAD
    bool "RT-Thread"
    help
        Use RT-Thread RTOS.
        License: Apache-2.0
        Website: https://www.rt-thread.io/

        Features:
        - Preemptive priority-based scheduler
        - Priority inheritance mutex
        - Semaphore, Event Flags
        - Mailbox, Message Queue
        - Memory Pool
        - Software Timer

config RTOS_CMSIS_RTX
    bool "CMSIS-RTOS2 (RTX5)"
    help
        Use ARM CMSIS-RTOS2 (RTX5).
        License: Apache-2.0
        Website: https://github.com/ARM-software/CMSIS_5

        Features:
        - CMSIS-RTOS2 standard API
        - Preemptive priority-based scheduler
        - Mutex, Semaphore, Event Flags
        - Message Queues
        - Memory Pools
        - Software Timers

endchoice

# ==================== FreeRTOS Configuration ====================

if RTOS_FREERTOS

menu "FreeRTOS Configuration"

config FREERTOS_CONFIG_PATH
    string "FreeRTOSConfig.h path"
    default "third_party/freertos/include"
    help
        Path to FreeRTOSConfig.h header file.

config FREERTOS_HEAP_TYPE
    int "FreeRTOS Heap Implementation"
    default 4
    range 1 5
    help
        Select the heap implementation scheme:
        1 - heap_1.c: Simple, no free
        2 - heap_2.c: Best fit, no coalescing
        3 - heap_3.c: Wrapper for malloc/free
        4 - heap_4.c: Coalescing adjacent blocks (RECOMMENDED)
        5 - heap_5.c: heap_4 with multiple regions

config FREERTOS_TICK_RATE
    int "FreeRTOS Tick Rate (Hz)"
    default 1000
    range 100 10000
    help
        FreeRTOS tick frequency in Hz.
        1000 = 1ms tick period.

config FREERTOS_MAX_PRIORITIES
    int "Maximum Priority Levels"
    default 32
    range 8 64
    help
        Maximum number of priority levels.

config FREERTOS_MINIMAL_STACK_SIZE
    int "Minimal Stack Size (words)"
    default 128
    help
        Minimal stack size for idle and timer tasks.

config FREERTOS_USE_TICKLESS
    bool "Enable Tickless Idle Mode"
    default n
    help
        Enable tickless idle mode for power saving.
        Requires low power timer support.

config FREERTOS_USE_TRACE
    bool "Enable Trace Facility"
    default n
    help
        Enable FreeRTOS trace facility for debugging.

endmenu

endif # RTOS_FREERTOS

# ==================== RT-Thread Configuration ====================

if RTOS_RTTHREAD

menu "RT-Thread Configuration"

config RTTHREAD_CONFIG_PATH
    string "rtconfig.h path"
    default "third_party/rt-thread"
    help
        Path to rtconfig.h header file.

config RTTHREAD_TICK_RATE
    int "RT-Thread Tick Rate (Hz)"
    default 1000
    range 100 10000
    help
        RT-Thread tick frequency in Hz.

config RTTHREAD_MAX_PRIORITIES
    int "Maximum Priority Levels"
    default 32
    range 8 64
    help
        Maximum number of priority levels.

config RTTHREAD_MINIMAL_STACK_SIZE
    int "Minimal Stack Size (bytes)"
    default 512
    help
        Minimal stack size for idle task.

config RTTHREAD_USE_COMPONENTS
    bool "Enable RT-Thread Components"
    default y
    help
        Enable RT-Thread components (DFS, SAL, etc.).

config RTTHREAD_CONSOLE_ENABLE
    bool "Enable Console Output"
    default y
    help
        Enable console output via finsh shell.

endmenu

endif # RTOS_RTTHREAD

# ==================== CMSIS-RTX Configuration ====================

if RTOS_CMSIS_RTX

menu "CMSIS-RTOS2 Configuration"

config RTX_CONFIG_PATH
    string "RTX_Config.h path"
    default "third_party/cmsis-rtx/Config"
    help
        Path to RTX_Config.h header file.

config RTX_TICK_RATE
    int "RTX Tick Rate (Hz)"
    default 1000
    range 100 10000
    help
        RTX tick frequency in Hz.

config RTX_MAX_PRIORITIES
    int "Maximum Priority Levels"
    default 56
    range 8 64
    help
        Maximum number of priority levels.

config RTX_OS_STACK_SIZE
    int "OS Stack Size (bytes)"
    default 1024
    help
        Stack size for OS system threads.

config RTX_OBJ_MEMORY
    int "Object Memory Size (bytes)"
    default 2048
    help
        Memory pool for OS objects.

config RTX_USE_THREAD_SAFE
    bool "Enable Thread Safety"
    default y
    help
        Enable thread-safe API calls.

endmenu

endif # RTOS_CMSIS_RTX

# ==================== Common Configuration ====================

menu "Common RTOS Configuration"

config OS_TICK_RATE
    int "System Tick Rate (Hz)"
    default 1000
    range 100 10000
    help
        System tick frequency for all RTOS.
        This is used by OSAL for timing functions.

config OS_USE_FLOAT
    bool "Enable Floating Point Support"
    default n
    help
        Enable floating point unit (FPU) support.
        Required for applications using float/double.

config OS_CHECK_STACK_OVERFLOW
    bool "Enable Stack Overflow Check"
    default y
    help
        Enable stack overflow detection.
        Adds runtime overhead but improves safety.

config OS_ENABLE_ASSERT
    bool "Enable RTOS Assertions"
    default y
    help
        Enable runtime assertions in RTOS.
        Useful for debugging, disable in production.

endmenu

endmenu
```
