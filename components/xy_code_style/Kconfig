## components/xy_code_style/Kconfig
```kconfig
# Kconfig for XY xy_code_style Component

config XY_XY_CODE_STYLE_ENABLE
    bool "xy_code_style component support"
    default n
    help
      Enable support for the xy_code_style component.
      This component provides various functionalities.

if XY_XY_CODE_STYLE_ENABLE

config XY_XY_CODE_STYLE_TEST
    bool "Enable xy_code_style component tests"
    default n
    depends on XY_XY_CODE_STYLE_ENABLE
    help
      Enable unit tests for the xy_code_style component.

config XY_XY_CODE_STYLE_EXAMPLE
    bool "Enable xy_code_style component examples"
    default n
    depends on XY_XY_CODE_STYLE_ENABLE
    help
      Enable example applications for the xy_code_style component.

endif # XY_XY_CODE_STYLE_ENABLE
```

## utils/templates/Kconfig.template
```kconfig
# Kconfig for XY @COMPONENT_NAME@ Component

config XY_@COMPONENT_NAME_UC@_ENABLE
    bool "@COMPONENT_NAME@ component support"
    default n
    help
      Enable support for the @COMPONENT_NAME@ component.
      This component provides @COMPONENT_DESCRIPTION@.

if XY_@COMPONENT_NAME_UC@_ENABLE

config XY_@COMPONENT_NAME_UC@_TEST
    bool "Enable @COMPONENT_NAME@ component tests"
    default n
    depends on XY_@COMPONENT_NAME_UC@_ENABLE
    help
      Enable unit tests for the @COMPONENT_NAME@ component.

config XY_@COMPONENT_NAME_UC@_EXAMPLE
    bool "Enable @COMPONENT_NAME@ component examples"
    default n
    depends on XY_@COMPONENT_NAME_UC@_ENABLE
    help
      Enable example applications for the @COMPONENT_NAME@ component.

endif # XY_@COMPONENT_NAME_UC@_ENABLE
```
