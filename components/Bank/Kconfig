## components/kernel/osal/Kconfig.osal
```kconfig
# XinYi OSAL Kconfig Configuration

menu "XinYi OSAL Configuration"

config XY_OSAL_ENABLED
    bool "Enable OSAL"
    default y
    help
        Enable XinYi Operating System Abstraction Layer

choice
    prompt "OSAL Backend Selection"
    default XY_OS_BACKEND_BAREMETAL
    help
        Select the RTOS backend for XY OSAL.
        Only one backend can be selected at a time.

config XY_OS_BACKEND_BAREMETAL
    bool "Bare-metal (No RTOS)"
    help
        Use bare-metal backend without RTOS.
        Provides basic kernel control and delay functions.
        Threading and synchronization features are stubs.

config XY_OS_BACKEND_FREERTOS
    bool "FreeRTOS"
    help
        Use FreeRTOS backend.
        Provides full RTOS features including:
        - Task management
        - Mutex, Semaphore, Event Groups
        - Message Queues
        - Software Timers

config XY_OS_BACKEND_RTTHREAD
    bool "RT-Thread"
    help
        Use RT-Thread backend.
        Provides full RTOS features including:
        - Thread management
        - Mutex with priority inheritance
        - Semaphore, Event Flags
        - Message Queues
        - Memory Pools
        - Software Timers

config XY_OS_BACKEND_CMSIS_RTX
    bool "CMSIS-RTX"
    help
        Use CMSIS-RTOS2 (RTX5) backend.
        Provides CMSIS-RTOS2 standard API.

endchoice

# Feature Configuration
menu "OSAL Features"

config XY_OS_FEATURE_THREAD
    bool "Enable Thread Management"
    default y
    depends on !XY_OS_BACKEND_BAREMETAL
    help
        Enable thread/task management features.
        Disabled for bare-metal backend.

config XY_OS_FEATURE_THREAD_FLAGS
    bool "Enable Thread Flags"
    default y
    depends on XY_OS_FEATURE_THREAD
    help
        Enable thread flags/notification features.

config XY_OS_FEATURE_MUTEX
    bool "Enable Mutex Support"
    default y
    depends on !XY_OS_BACKEND_BAREMETAL
    help
        Enable mutex synchronization primitive.

config XY_OS_FEATURE_SEMAPHORE
    bool "Enable Semaphore Support"
    default y
    depends on !XY_OS_BACKEND_BAREMETAL
    help
        Enable semaphore synchronization primitive.

config XY_OS_FEATURE_EVENT_FLAGS
    bool "Enable Event Flags Support"
    default y
    depends on !XY_OS_BACKEND_BAREMETAL
    help
        Enable event flags synchronization primitive.

config XY_OS_FEATURE_MESSAGE_QUEUE
    bool "Enable Message Queue Support"
    default y
    depends on !XY_OS_BACKEND_BAREMETAL
    help
        Enable inter-thread message queues.

config XY_OS_FEATURE_MEMORY_POOL
    bool "Enable Memory Pool Support"
    default y
    depends on !XY_OS_BACKEND_BAREMETAL
    help
        Enable fixed-size memory pool allocation.

config XY_OS_FEATURE_TIMER
    bool "Enable Software Timer Support"
    default y
    depends on !XY_OS_BACKEND_BAREMETAL
    help
        Enable software timers.
        Bare-metal backend uses xy_timer_sw module.

config XY_OS_FEATURE_DELAY
    bool "Enable Delay Functions"
    default y
    help
        Enable delay and delay_until functions.

endchoice

# Configuration Parameters
menu "OSAL Parameters"

config XY_OS_DEFAULT_STACK_SIZE
    int "Default Thread Stack Size"
    default 1024 if XY_OS_BACKEND_BAREMETAL
    default 2048 if XY_OS_BACKEND_FREERTOS
    default 2048 if XY_OS_BACKEND_RTTHREAD
    default 2048 if XY_OS_BACKEND_CMSIS_RTX
    help
        Default stack size for threads in bytes.

config XY_OS_DEFAULT_PRIORITY
    int "Default Thread Priority"
    default 24
    range 0 56
    help
        Default priority for new threads.
        Range: 0 (lowest) to 56 (highest).

config XY_OS_TICK_FREQ
    int "System Tick Frequency (Hz)"
    default 1000
    help
        System tick frequency in Hz.
        1000 = 1ms tick period.

config XY_OS_MAX_PRIORITY_LEVELS
    int "Maximum Priority Levels"
    default 57
    help
        Number of priority levels (0 to N-1).

config XY_OS_DEFAULT_TIMEOUT
    int "Default Timeout (ticks)"
    default 5000
    help
        Default timeout for blocking operations in ticks.

endchoice

# Debug and Safety
menu "Debug and Safety"

config XY_OS_PARAM_CHECK
    bool "Enable Parameter Validation"
    default y
    help
        Enable parameter validation checks.
        Disable in production for smaller code size.

config XY_OS_ISR_CHECK
    bool "Enable ISR Context Detection"
    default y
    help
        Enable ISR context detection.
        Helps prevent API misuse from interrupt handlers.

config XY_OS_NULL_CHECK
    bool "Enable NULL Pointer Checks"
    default y
    help
        Enable NULL pointer validation.

config XY_OS_ENABLE_STATS
    bool "Enable Statistics Collection"
    default n
    help
        Enable OSAL statistics collection.
        Useful for debugging and performance analysis.

endchoice

# Backend-Specific Configuration
menu "Backend-Specific Configuration"

config XY_OS_FREERTOS_USE_TICKLESS
    bool "Enable FreeRTOS Tickless Idle Mode"
    default n
    depends on XY_OS_BACKEND_FREERTOS
    help
        Enable tickless idle mode for power saving.

config XY_OS_FREERTOS_HEAP_TYPE
    int "FreeRTOS Heap Type"
    default 4
    range 1 5
    depends on XY_OS_BACKEND_FREERTOS
    help
        FreeRTOS memory heap scheme (1-5).
        heap_4 is recommended for most applications.

config XY_OS_RTTHREAD_HOOK_ENABLE
    bool "Enable RT-Thread Hooks"
    default n
    depends on XY_OS_BACKEND_RTTHREAD
    help
        Enable RT-Thread callback hooks.

config XY_OS_BAREMETAL_USE_SYSTICK
    bool "Use SysTick for Bare-metal Timing"
    default y
    depends on XY_OS_BACKEND_BAREMETAL
    help
        Use ARM SysTick timer for bare-metal timing.

config XY_OS_BAREMETAL_MAX_TIMERS
    int "Maximum Software Timers (Bare-metal)"
    default 8
    depends on XY_OS_BACKEND_BAREMETAL
    help
        Maximum number of software timers in bare-metal mode.

endchoice

# Size Limits
menu "Size Limits"

config XY_OS_MAX_NAME_LENGTH
    int "Maximum Object Name Length"
    default 16
    help
        Maximum name length for OS objects (threads, mutexes, etc.).

config XY_OS_MAX_THREAD_COUNT
    int "Maximum Thread Count"
    default 32
    depends on XY_OS_FEATURE_THREAD
    help
        Maximum number of threads that can be enumerated.

endchoice

endmenu
```

## components/misc/Kconfig
```kconfig
# Kconfig for XY misc Component

config XY_MISC_ENABLE
    bool "misc component support"
    default n
    help
      Enable support for the misc component.
      This component provides miscellaneous components.

if XY_MISC_ENABLE

config XY_MISC_TEST
    bool "Enable misc component tests"
    default n
    depends on XY_MISC_ENABLE
    help
      Enable unit tests for the misc component.

config XY_MISC_EXAMPLE
    bool "Enable misc component examples"
    default n
    depends on XY_MISC_ENABLE
    help
      Enable example applications for the misc component.

endif # XY_MISC_ENABLE
```

## components/net/Kconfig
```kconfig
# Kconfig for XY net Component

config XY_NET_ENABLE
    bool "net component support"
    default n
    help
      Enable support for the net component.
      This component provides network protocols (MQTT, Modbus, AT, etc.).

if XY_NET_ENABLE

config XY_NET_TEST
    bool "Enable net component tests"
    default n
    depends on XY_NET_ENABLE
    help
      Enable unit tests for the net component.

config XY_NET_EXAMPLE
    bool "Enable net component examples"
    default n
    depends on XY_NET_ENABLE
    help
      Enable example applications for the net component.

endif # XY_NET_ENABLE
```

## components/pid/Kconfig
```kconfig
config COMPONENT_PID
    bool "PID Controller"
    default y
    help
      PID (Proportional-Integral-Derivative) controller.

config PID_DEFAULT_KP
    float "Default Proportional Gain"
    default 1.0

config PID_DEFAULT_KI
    float "Default Integral Gain"
    default 0.1

config PID_DEFAULT_KD
    float "Default Derivative Gain"
    default 0.05
```

## components/pm/Kconfig
```kconfig
# Kconfig for XY pm Component

config XY_PM_ENABLE
    bool "pm component support"
    default n
    help
      Enable support for the pm component.
      This component provides power management.

if XY_PM_ENABLE

config XY_PM_TEST
    bool "Enable pm component tests"
    default n
    depends on XY_PM_ENABLE
    help
      Enable unit tests for the pm component.

config XY_PM_EXAMPLE
    bool "Enable pm component examples"
    default n
    depends on XY_PM_ENABLE
    help
      Enable example applications for the pm component.

config XY_CHARGER_ENABLE
    bool "Enable charger support"
    default n
    depends on XY_PM_ENABLE
    help
      Enable battery charger support with GPIO control.

config XY_CHARGER_GPIO_PORT
    int "Charger enable GPIO port"
    default 0
    depends on XY_CHARGER_ENABLE
    help
      GPIO port number for charger enable pin (platform-specific).

config XY_CHARGER_GPIO_PIN
    int "Charger enable GPIO pin"
    default 0
    depends on XY_CHARGER_ENABLE
    help
      GPIO pin number for charger enable pin.

config XY_CHARGER_ACTIVE_HIGH
    bool "Charger enable active high"
    default y
    depends on XY_CHARGER_ENABLE
    help
      Set to y if charger enable is active high, n for active low.

config XY_FUEL_GAUGE_ENABLE
    bool "Enable fuel gauge support"
    default n
    depends on XY_PM_ENABLE
    help
      Enable fuel gauge (battery capacity) support.

endif # XY_PM_ENABLE
```

## components/sys/Kconfig
```kconfig
config COMPONENT_SYS
    bool "System Components"
    default y

config SYS_STATE_MACHINE
    bool "State Machine Framework"
    default y
    depends on COMPONENT_SYS

config SYS_TIMER
    bool "Software Timer"
    default y
    depends on COMPONENT_SYS

config SYS_MAX_TIMERS
    int "Maximum timers"
    default 8
    range 4 32
```

## components/sys/xy_state_machine/Kconfig
```kconfig
# Kconfig for XY xy_state_machine Component

config XY_XY_STATE_MACHINE_ENABLE
    bool "xy_state_machine component support"
    default n
    help
      Enable support for the xy_state_machine component.
      This component provides state machine framework.

if XY_XY_STATE_MACHINE_ENABLE

config XY_XY_STATE_MACHINE_TEST
    bool "Enable xy_state_machine component tests"
    default n
    depends on XY_XY_STATE_MACHINE_ENABLE
    help
      Enable unit tests for the xy_state_machine component.

config XY_XY_STATE_MACHINE_EXAMPLE
    bool "Enable xy_state_machine component examples"
    default n
    depends on XY_XY_STATE_MACHINE_ENABLE
    help
      Enable example applications for the xy_state_machine component.

endif # XY_XY_STATE_MACHINE_ENABLE
```

## components/time_tick/Kconfig
```kconfig
# Kconfig for XY time_tick Component

config XY_TIME_TICK_ENABLE
    bool "time_tick component support"
    default n
    help
      Enable support for the time_tick component.
      This component provides time tick management.

if XY_TIME_TICK_ENABLE

config XY_TIME_TICK_TEST
    bool "Enable time_tick component tests"
    default n
    depends on XY_TIME_TICK_ENABLE
    help
      Enable unit tests for the time_tick component.

config XY_TIME_TICK_EXAMPLE
    bool "Enable time_tick component examples"
    default n
    depends on XY_TIME_TICK_ENABLE
    help
      Enable example applications for the time_tick component.

endif # XY_TIME_TICK_ENABLE
```

## components/trace/Kconfig
```kconfig
# Kconfig for XY trace Component

config XY_TRACE_ENABLE
    bool "trace component support"
    default n
    help
      Enable support for the trace component.
      This component provides logging system.

if XY_TRACE_ENABLE

config XY_TRACE_TEST
    bool "Enable trace component tests"
    default n
    depends on XY_TRACE_ENABLE
    help
      Enable unit tests for the trace component.

config XY_TRACE_EXAMPLE
    bool "Enable trace component examples"
    default n
    depends on XY_TRACE_ENABLE
    help
      Enable example applications for the trace component.

endif # XY_TRACE_ENABLE
```
