/* Font data include file - generated from font arrays */
FONT_CHAR_DATA(font_space)
FONT_CHAR_DATA(font_exclam)
FONT_CHAR_DATA(font_quotedbl)
FONT_CHAR_DATA(font_numbersign)
FONT_CHAR_DATA(font_dollar)
FONT_CHAR_DATA(font_percent)
FONT_CHAR_DATA(font_ampersand)
FONT_CHAR_DATA(font_apostrophe)
FONT_CHAR_DATA(font_parenleft)
FONT_CHAR_DATA(font_parenright)
FONT_CHAR_DATA(font_asterisk)
FONT_CHAR_DATA(font_plus)
FONT_CHAR_DATA(font_comma)
FONT_CHAR_DATA(font_minus)
FONT_CHAR_DATA(font_period)
FONT_CHAR_DATA(font_slash)
FONT_CHAR_DATA(font_0)
FONT_CHAR_DATA(font_1)
FONT_CHAR_DATA(font_2)
FONT_CHAR_DATA(font_3)
FONT_CHAR_DATA(font_4)
FONT_CHAR_DATA(font_5)
FONT_CHAR_DATA(font_6)
FONT_CHAR_DATA(font_7)
FONT_CHAR_DATA(font_8)
FONT_CHAR_DATA(font_9)
FONT_CHAR_DATA(font_colon)
FONT_CHAR_DATA(font_semicolon)
FONT_CHAR_DATA(font_less)
FONT_CHAR_DATA(font_equal)
FONT_CHAR_DATA(font_greater)
FONT_CHAR_DATA(font_question)
FONT_CHAR_DATA(font_at)
FONT_CHAR_DATA(font_A)
FONT_CHAR_DATA(font_B)
FONT_CHAR_DATA(font_C)
FONT_CHAR_DATA(font_D)
FONT_CHAR_DATA(font_E)
FONT_CHAR_DATA(font_F)
FONT_CHAR_DATA(font_G)
FONT_CHAR_DATA(font_H)
FONT_CHAR_DATA(font_I)
FONT_CHAR_DATA(font_J)
FONT_CHAR_DATA(font_K)
FONT_CHAR_DATA(font_L)
FONT_CHAR_DATA(font_M)
FONT_CHAR_DATA(font_N)
FONT_CHAR_DATA(font_O)
FONT_CHAR_DATA(font_P)
FONT_CHAR_DATA(font_Q)
FONT_CHAR_DATA(font_R)
FONT_CHAR_DATA(font_S)
FONT_CHAR_DATA(font_T)
FONT_CHAR_DATA(font_U)
FONT_CHAR_DATA(font_V)
FONT_CHAR_DATA(font_W)
FONT_CHAR_DATA(font_X)
FONT_CHAR_DATA(font_Y)
FONT_CHAR_DATA(font_Z)
FONT_CHAR_DATA(font_bracketleft)
FONT_CHAR_DATA(font_backslash)
FONT_CHAR_DATA(font_bracketright)
FONT_CHAR_DATA(font_asciicircum)
FONT_CHAR_DATA(font_underscore)
FONT_CHAR_DATA(font_grave)
FONT_CHAR_DATA(font_a)
FONT_CHAR_DATA(font_b)
FONT_CHAR_DATA(font_c)
FONT_CHAR_DATA(font_d)
FONT_CHAR_DATA(font_e)
FONT_CHAR_DATA(font_f)
FONT_CHAR_DATA(font_g)
FONT_CHAR_DATA(font_h)
FONT_CHAR_DATA(font_i)
FONT_CHAR_DATA(font_j)
FONT_CHAR_DATA(font_k)
FONT_CHAR_DATA(font_l)
FONT_CHAR_DATA(font_m)
FONT_CHAR_DATA(font_n)
FONT_CHAR_DATA(font_o)
FONT_CHAR_DATA(font_p)
FONT_CHAR_DATA(font_q)
FONT_CHAR_DATA(font_r)
FONT_CHAR_DATA(font_s)
FONT_CHAR_DATA(font_t)
FONT_CHAR_DATA(font_u)
FONT_CHAR_DATA(font_v)
FONT_CHAR_DATA(font_w)
FONT_CHAR_DATA(font_x)
FONT_CHAR_DATA(font_y)
FONT_CHAR_DATA(font_z)
FONT_CHAR_DATA(font_braceleft)
FONT_CHAR_DATA(font_bar)
FONT_CHAR_DATA(font_braceright)
FONT_CHAR_DATA(font_asciitilde)
